## drivers/misc/quicklogic/Kconfig
```kconfig
#
# Mobile Quick logic bridge configuration
config VX6B3E_BRIDGE
	boolean "VX6B3E chip"
	depends on I2C && I2C_PXA
	default n
	help
	  If you say yes here, you support for it.

	  This driver can NOT be built as a module.
```

## drivers/sensor/Kconfig
```kconfig
#
# Sensor  drivers configuration
#
config SENSOR_DIR
	tristate "Sensors core of sensor folder"
	default n
	help
	  Say Y here to enable debugging messages for power supply class
	  and drivers.

config SENSORS_BMA254
	tristate "BMA254 Acceleration Sensor Driver"
	depends on I2C
	default n
	help
	  If you say yes here you get support for Bosch-Sensortec's
	  BMA254 Acceleration Sensor.

config INPUT_BMA254_ACC_ALERT_INT
	tristate "BMA254 acceleration sensor motion support"
	depends on SENSORS_BMA254
	default n
	help
	  If you say yes here you get support for Bosch Sensortec's 
	  acceleration sensors BMA254 Motion support.	

config SENSORS_TAOS
	depends on I2C
	tristate "TAOS driver"
	default n
	help
	  If you say yes here you get support for TAOS's
	  TMD27723 proximity & light sensor using taos driver.
```

## drivers/switch/Kconfig
```kconfig
menuconfig SWITCH
	tristate "Switch class support"
	help
	  Say Y here to enable switch class support. This allows
	  monitoring switches by userspace via sysfs and uevent.

if SWITCH

config SWITCH_GPIO
	tristate "GPIO Swith support"
	depends on GENERIC_GPIO
	help
	  Say Y here to enable GPIO based switch support.

config SWITCH_88PM860X_HS
	tristate "88pm806x Headset Switch support"
	depends on GENERIC_GPIO && MFD_88PM860X
	help
	  Say Y here to enable 88pm860x headset & hook switch support.

config SWITCH_88PM800_HS
	tristate "88pm800 Headset Switch support"
	depends on GENERIC_GPIO && MFD_88PM800
	help
	  Say Y here to enable headset & hook switch support.

config SWITCH_88CE170_HS
	tristate "88ce170 Headset Switch support"
	depends on GENERIC_GPIO && MFD_88CE170
	help
	  Say Y here to enable ce170 headset & hook switch support.

endif # SWITCH
```
